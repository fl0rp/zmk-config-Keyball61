## config/west.yml
```yaml
manifest:
  remotes:
    - name: zmkfirmware
      url-base: https://github.com/zmkfirmware
    - name: fl0rp
      url-base: https://github.com/fl0rp
  projects:
    - name: zmk
      remote: zmkfirmware
      revision: v0.3
      import: app/west.yml
    - name: zmk-pmw3XXX-driver
      remote: fl0rp
      revision: pmw3360
  self:
    path: config
```
